## arch/arm/mach-stm32/stm32h7/Kconfig
```kconfig
if STM32H7

config TARGET_STM32H743_DISCO
	bool "STM32H743 Discovery board"

config TARGET_STM32H743_EVAL
	bool "STM32H743 Evaluation board"

config TARGET_STM32H7_SOM
	bool "Emcraft Systems STM32H7 SOM"

source "board/st/stm32h743-eval/Kconfig"
source "board/st/stm32h743-disco/Kconfig"
source "board/emcraft/stm32h7-som/Kconfig"

endif
```

## board/emcraft/stm32h7-som/Kconfig
```kconfig
if TARGET_STM32H7_SOM

config SYS_BOARD
	string
	default "stm32h7-som"

config SYS_VENDOR
	string
	default "emcraft"

config SYS_SOC
	string
	default "stm32h7"

config SYS_CONFIG_NAME
	string
	default "stm32h7-som"

config SPL_STM32H7_SOM
	bool ""
	select SPL
	select SPL_BOARD_INIT
	select SPL_CLK
	select SPL_DM
	select SPL_DM_SERIAL
	select SPL_DM_RESET
	select SPL_DM_SEQ_ALIAS
	select SPL_DRIVERS_MISC_SUPPORT
	select SPL_GPIO_SUPPORT
	select SPL_LIBCOMMON_SUPPORT
	select SPL_LIBGENERIC_SUPPORT
	select SPL_MTD_SUPPORT
	select SPL_OF_CONTROL
	select SPL_OF_LIBFDT
	select SPL_OF_TRANSLATE
	select SPL_PINCTRL
	select SPL_RAM
	select SPL_SERIAL_SUPPORT
	select SPL_SYS_MALLOC_SIMPLE
	select SPL_TIMER
	select SUPPORT_SPL
endif
```

## configs/stm32h7_som_defconfig
```kconfig
CONFIG_ARM=y
CONFIG_STM32=y
CONFIG_SYS_TEXT_BASE=0x24001000
CONFIG_SYS_MALLOC_F_LEN=0xF00
CONFIG_SPL_SYS_MALLOC_F_LEN=0x8000
CONFIG_STM32H7=y
CONFIG_TARGET_STM32H7_SOM=y
CONFIG_SPL_STM32H7_SOM=y
CONFIG_SPL_SPI_FLASH_SUPPORT=y
CONFIG_SPL_SPI_SUPPORT=y
CONFIG_NR_DRAM_BANKS=1
CONFIG_BOOTDELAY=3
CONFIG_DEFAULT_FDT_FILE="stm32h7-som"
# CONFIG_DISPLAY_CPUINFO is not set
CONFIG_BOARD_EARLY_INIT_F=y
CONFIG_SPL_LEGACY_IMAGE_CRC_CHECK=y
CONFIG_SPL_SHELL_SUPPORT=y
CONFIG_SPL_KERMIT_SUPPORT=y
CONFIG_SPL_SPI_LOAD=y
CONFIG_HUSH_PARSER=y
CONFIG_SYS_PROMPT="STM32H7-SOM U-Boot > "
CONFIG_CMD_GPT=y
CONFIG_CMD_MMC=y
CONFIG_CMD_MTD=y
CONFIG_CMD_SF=y
# CONFIG_CMD_SETEXPR is not set
CONFIG_CMD_CACHE=y
CONFIG_CMD_TIMER=y
CONFIG_CMD_FAT=y
CONFIG_CMD_UBI=y
CONFIG_OF_CONTROL=y
CONFIG_DEFAULT_DEVICE_TREE="stm32h7-som"
CONFIG_ENV_IS_IN_UBI=y
CONFIG_SPL_REGMAP=y
CONFIG_SPL_SYSCON=y
CONFIG_DM_MMC=y
CONFIG_STM32_SDMMC2=y
CONFIG_MTD=y
CONFIG_MTD_NOR_FLASH=y
CONFIG_MTD_SPI_NAND=y
CONFIG_DM_SPI_FLASH=y
CONFIG_SPI_FLASH=y
CONFIG_SPI_FLASH_ISSI=y
CONFIG_SPI_FLASH_MACRONIX=y
CONFIG_SPI_FLASH_SPANSION=y
CONFIG_SPI_FLASH_WINBOND=y
CONFIG_SPI_FLASH_MTD=y
# CONFIG_CONFIG_UBI_SILENCE_MSG is not set
CONFIG_MTD_UBI_FASTMAP=y
# CONFIG_PINCTRL_FULL is not set
CONFIG_SPI=y
CONFIG_DM_SPI=y
CONFIG_STM32_QSPI=y
# CONFIG_UBIFS_SILENCE_MSG is not set
CONFIG_OF_LIBFDT_OVERLAY=y
# CONFIG_EFI_LOADER is not set
```

## dts/dummy.its
```
/* Dummy its to invoke mkimage to add signature keys to the U-Boot's dtb */
/dts-v1/;

/ {
	description = "Dummy Image";
	#address-cells = <1>;
	images {
		fdt {
			description = "Dummy Image";
			data = /incbin/("dummy.its");
			type = "flat_dt";
			arch = "arm";
			compression = "none";
			fdt-version = <1>;
			hash-1 {
				algo = "sha1";
			};
		};
	};

	configurations {
		default = "config-1";
		config-1 {
			description = "Dummy Image";
			fdt = "fdt";
			signature {
				algo = "sha1,rsa2048";
				key-name-hint = "dev";
				sign-images = "fdt";
			};
		};
	};
};
```
